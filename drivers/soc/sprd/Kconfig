## drivers/soc/sprd/Kconfig
```kconfig
# SPDX-License-Identifier: GPL-2.0-only

menu "Spreadtrum and Unisoc SoC drivers"

config SPRD_AGDSP
	tristate "Audio DSP support"
	depends on ARCH_SPRD || COMPILE_TEST
	depends on MAILBOX
	help
	  Say y here to enable support for communication with the audio
	  DSP found in Spreadtrum/Unisoc SoCs.

config SPRD_AUDCP_BOOT
	tristate "Audio DSP (AUDCP) boot support"
	depends on ARCH_SPRD || COMPILE_TEST
	help
	  Say y here to load firmware into and boot the audio co-processor
	  (AUDCP / AGDSP) on Spreadtrum/Unisoc SoCs, so the sprd-agdsp IPC
	  and ASoC audio stack can communicate with it.

endmenu
```

## sound/soc/sprd/vendor/Kconfig
```kconfig
# SPDX-License-Identifier: GPL-2.0-only
config SND_SOC_UNISOC_VBC_V4_SC2730
	bool "Vendor-ported UMS512 audio stack (VBC v4 + SC2730 codec)"
	depends on ARCH_SPRD || COMPILE_TEST
	depends on MAILBOX && MFD_SC27XX_PMIC
	select REGMAP_MMIO
	help
	  Faithful port of the Unisoc 5.4 BSP audio stack for the
	  sharkl5pro/UMS512: audio SIPC over the AGDSP mailbox, audio
	  shared-memory manager, AGDSP access control, AGCP dmaengine PCM
	  platform, PCM routing, FE DAIs, VBC v4 DAI, SC2730 analog codec,
	  audio power regulators and the vbc-v4-codec-sc2730 machine card.
	  Needed for the NORMAL_AP01 playback path on the RG Rotate.
```
